## config/module/Kconfig
```kconfig
DT_COMPAT_ZMK_BEHAVIOR_CAPS_WORD_EXT := zmk,behavior-caps-word-ext

config ZMK_BEHAVIOR_CAPS_WORD_EXT
    bool
    default $(dt_compat_enabled,$(DT_COMPAT_ZMK_BEHAVIOR_CAPS_WORD_EXT))

DT_COMPAT_ZMK_BEHAVIOR_STICKY_KEY_EXT := zmk,behavior-sticky-key-ext

config ZMK_BEHAVIOR_STICKY_KEY_EXT
    bool
    default $(dt_compat_enabled,$(DT_COMPAT_ZMK_BEHAVIOR_STICKY_KEY_EXT))

config ZMK_BEHAVIOR_STICKY_KEY_EXT_MAX_HELD
    int "Sticky Key Ext Max Held"
    default 10
    depends on ZMK_BEHAVIOR_STICKY_KEY_EXT
    help
      Max number of simultaneously held sticky_key_ext keys
```
